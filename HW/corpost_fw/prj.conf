## CMakeLists.txt
```
cmake_minimum_required(VERSION 3.20.0)
find_package(Zephyr REQUIRED HINTS $ENV{ZEPHYR_BASE})

project(corpost_fw)

target_sources(app PRIVATE
	src/main.c
	src/bno055.c
	src/vibro.c
	src/posture.c
	src/ble.c
)
```

## prj.conf
```kconfig
# Sensor and actuator bus
CONFIG_I2C=y
# DK buttons (1: recalibrate, 2: delete pairing)
CONFIG_GPIO=y
# Hardware floating-point calculations (Cortex-M4F)
CONFIG_FPU=y

# RTT console (J-Link)
CONFIG_USE_SEGGER_RTT=y
CONFIG_RTT_CONSOLE=y
CONFIG_UART_CONSOLE=n
CONFIG_PRINTK=y

# Packet CRC-16
CONFIG_CRC=y

# ---------------------------------------------------------------------------
# Bluetooth Low Energy: peripheral (GAP) and GATT server
# ---------------------------------------------------------------------------
CONFIG_BT=y
CONFIG_BT_PERIPHERAL=y
CONFIG_BT_DEVICE_NAME="CorPost"
CONFIG_BT_MAX_CONN=1

# Preferred connection parameters (the phone decides; the nRF requests them after 5 s)
#   interval 100-200 ms (units of 1.25 ms), latency 4, timeout 4 s (units of 10 ms)
CONFIG_BT_PERIPHERAL_PREF_MIN_INT=80
CONFIG_BT_PERIPHERAL_PREF_MAX_INT=160
CONFIG_BT_PERIPHERAL_PREF_LATENCY=4
CONFIG_BT_PERIPHERAL_PREF_TIMEOUT=400

# MTU: the packet is 24 B and the default MTU (23) leaves only 20 B of data.
# On connection the nRF requests an MTU of 247 (the phone answers with its own).
CONFIG_BT_GATT_CLIENT=y
CONFIG_BT_GATT_AUTO_UPDATE_MTU=y
CONFIG_BT_L2CAP_TX_MTU=247
CONFIG_BT_BUF_ACL_RX_SIZE=251
CONFIG_BT_BUF_ACL_TX_SIZE=251
# (Data Length Extension is already 251 by default in the Nordic controller:
#  the packet travels in a single radio frame)

# ---------------------------------------------------------------------------
# Security
# ---------------------------------------------------------------------------
# Pairing: LE Secure Connections only (ECDH P-256 + AES-CCM 128) and
# authenticated (level 4). "Legacy" and "Just Works" pairing are rejected.
CONFIG_BT_SMP=y
CONFIG_BT_SMP_SC_ONLY=y
# Bonding: the keys are stored in flash.
# Up to 3 paired phones. With a single slot, a second phone cannot pair:
# bt_conn_set_security returns -ENOMEM and the passkey is never shown.
CONFIG_BT_BONDABLE=y
CONFIG_BT_MAX_PAIRED=3
# Privacy: random address that changes (RPA), so the device cannot be tracked
# TEST Android 14 (error 135): privacy temporarily disabled
# CONFIG_BT_PRIVACY=y

# Persistent storage of the bonds (settings over NVS in flash)
CONFIG_BT_SETTINGS=y
CONFIG_SETTINGS=y
CONFIG_FLASH=y
CONFIG_FLASH_PAGE_LAYOUT=y
CONFIG_FLASH_MAP=y
CONFIG_NVS=y
```

## app.overlay
```dts
/* I2C bus settings for the BNO055 (long cables, unknown pull-ups).
 * 1) Use the TWIM peripheral with EasyDMA instead of the board's CPU-driven TWI.
 * 2) Force 100 kHz.
 * 3) Enable the internal SDA/SCL pull-ups (~13 kΩ; they help, but do not replace external 4.7 kΩ ones). */
&i2c0 {
	compatible = "nordic,nrf-twim";
	clock-frequency = <I2C_BITRATE_STANDARD>;
};

&i2c0_default {
	group1 {
		bias-pull-up;
	};
};
```

## src/main.c
```c
/* CorPost - device firmware (PoC).
 *
 * Hardware: nRF52-DK (nRF52832) -> Modulino Vibro (0x38) -> BNO055 (0x28/0x29), all over I2C.
 *
 * How it works:
 *  1. Start BLE (advertising "CorPost", secure pairing with passkey).
 *  2. Calibration: wait until the user is still and store that posture as 0°.
 *     The Vibro gives a short pulse to confirm. DK Button 1 (or command
 *     0x03 over BLE) repeats the calibration.
 *  3. At every interval, take a 2 s window (50 samples at 25 Hz).
 *  4. Motion filter: if the user is moving, the window is INVALID (no vibration).
 *  5. Otherwise, compute the angle relative to the reference: OK or BAD depending on the tolerance.
 *  6. If BAD, the Vibro gives the alert (two pulses), respecting VIB_MIN_INTERVAL_S.
 *  7. The reading is stored in the buffer and sent over BLE (24 B notification)
 *     as soon as the link is ready. Without a connection, it accumulates (up to 50).
 *
 * DK Button 2: deletes the stored pairing (to pair another phone).
 *
 * Pending: decision tree instead of the threshold.
 * The RTT output is for debugging. */
#include <zephyr/kernel.h>
#include <zephyr/device.h>
#include <zephyr/drivers/i2c.h>
#include <zephyr/drivers/gpio.h>
#include <stdbool.h>
#include <stdlib.h>

#include "config.h"
#include "bno055.h"
#include "vibro.h"
#include "posture.h"
#include "ble.h"

static const struct device *i2c = DEVICE_DT_GET(DT_NODELABEL(arduino_i2c));
static const struct gpio_dt_spec button1 = GPIO_DT_SPEC_GET(DT_ALIAS(sw0), gpios);
static const struct gpio_dt_spec button2 = GPIO_DT_SPEC_GET(DT_ALIAS(sw1), gpios);
static struct gpio_callback button1_cb, button2_cb;

/* Flags and parameters changed by the interrupts or by the Bluetooth thread */
static volatile bool recalibrate;
static volatile bool clear_bonds;
static volatile uint16_t interval_s = MEASURE_INTERVAL_S;
static volatile bool vibration_on = true;

static struct imu_sample win[WINDOW_SAMPLES];
static bool win_ok[WINDOW_SAMPLES];

/* printk without float support: print with 1 decimal */
static void print_f1(const char *label, float v)
{
	int t = (int)(v * 10.0f + (v >= 0 ? 0.5f : -0.5f));

	printk("%s=%s%d.%d ", label, t < 0 ? "-" : "", abs(t) / 10, abs(t) % 10);
}

/* --- Buttons ------------------------------------------------------------- */
static void on_button1(const struct device *dev, struct gpio_callback *cb, uint32_t pins)
{
	recalibrate = true;
}

static void on_button2(const struct device *dev, struct gpio_callback *cb, uint32_t pins)
{
	clear_bonds = true;
}

static void button_setup(const struct gpio_dt_spec *b, struct gpio_callback *cb,
			 gpio_callback_handler_t handler)
{
	if (!gpio_is_ready_dt(b)) {
		printk("Button not available\n");
		return;
	}
	gpio_pin_configure_dt(b, GPIO_INPUT);
	gpio_pin_interrupt_configure_dt(b, GPIO_INT_EDGE_TO_ACTIVE);
	gpio_init_callback(cb, handler, BIT(b->pin));
	gpio_add_callback(b->port, cb);
}

/* --- BLE commands (they run on the Bluetooth thread: they only store the value) --- */
static void cmd_set_interval(uint16_t s)
{
	interval_s = s;
}

static void cmd_set_tolerance(uint8_t deg)
{
	posture_set_tolerance(deg);
}

static void cmd_recalibrate(void)
{
	recalibrate = true;
}

static void cmd_set_vibration(bool on)
{
	vibration_on = on;
}

static const struct ble_cmd_handlers cmd_handlers = {
	.set_interval = cmd_set_interval,
	.set_tolerance = cmd_set_tolerance,
	.recalibrate = cmd_recalibrate,
	.set_vibration = cmd_set_vibration,
};

/* --- Measurement ---------------------------------------------------------- */
static void scan(void)
{
	uint8_t dummy;

	printk("I2C devices:");
	for (uint8_t addr = 0x08; addr < 0x78; addr++) {
		if (i2c_read(i2c, &dummy, 1, addr) == 0) {
			printk(" 0x%02x", addr);
		}
	}
	printk("\n");
}

/* Take a window of WINDOW_SAMPLES at 25 Hz. Lost samples are marked in win_ok. */
static void capture_window(void)
{
	int64_t next = k_uptime_get();

	for (int i = 0; i < WINDOW_SAMPLES; i++) {
		win_ok[i] = (bno055_read(&win[i]) == 0);
		next += SAMPLE_PERIOD_MS;

		int64_t wait = next - k_uptime_get();

		if (wait > 0) {
			k_msleep(wait);
		}
	}
}

/* Repeat windows until a still one is found and use it as the reference posture */
static void calibrate(void)
{
	struct window_result r;

	recalibrate = false;
	printk("Calibrating: stay still in the correct posture...\n");
	while (1) {
		capture_window();
		posture_window_stats(win, win_ok, WINDOW_SAMPLES, &r);
		if (r.n_valid >= MIN_VALID_SAMPLES && r.amag_std_mg <= MOTION_STD_MG) {
			break;
		}
		print_f1("  moving, std_mg", r.amag_std_mg);
		printk("retrying\n");
	}
	posture_set_reference(r.acc_mean);
	printk("Reference (mg): ");
	print_f1("x", r.acc_mean[0]);
	print_f1("y", r.acc_mean[1]);
	print_f1("z", r.acc_mean[2]);
	printk("\n");
	vibro_pulse(1000, 150, 60); /* confirmation */
}

/* Tasks handled while waiting for the next interval */
static void service_ble(void)
{
	if (clear_bonds) {
		clear_bonds = false;
		ble_clear_bonds();
	}
	ble_flush();
}

int main(void)
{
	if (!device_is_ready(i2c)) {
		printk("I2C is not ready\n");
		return 0;
	}

	k_msleep(3000); /* time to connect RTT and for the BNO055 to start up */
	printk("*** CorPost firmware (PoC) ***\n");
	scan();

	if (bno055_init(i2c) != 0) {
		printk("ERROR: BNO055 not found or could not be configured\n");
		return 0;
	}
	printk("BNO055 at 0x%02x\n", bno055_addr());

	if (vibro_init(i2c) != 0) {
		printk("WARNING: the Modulino Vibro does not respond at 0x%02x (continuing without vibration)\n",
		       VIBRO_ADDR);
	} else {
		printk("Modulino Vibro at 0x%02x\n", VIBRO_ADDR);
	}

	button_setup(&button1, &button1_cb, on_button1);
	button_setup(&button2, &button2_cb, on_button2);

	if (ble_init(&cmd_handlers) != 0) {
		printk("WARNING: BLE not available (continuing without sending data)\n");
	}

	printk("Interval %d s, window %d samples at %d Hz, tolerance %d degrees\n",
	       MEASURE_INTERVAL_S, WINDOW_SAMPLES, 1000 / SAMPLE_PERIOD_MS, (int)TOLERANCE_DEG);

	calibrate();

	int64_t last_vib = -((int64_t)VIB_MIN_INTERVAL_S * 1000) - 1;

	while (1) {
		int64_t t0 = k_uptime_get();

		if (recalibrate) {
			calibrate();
		}

		struct window_result r;

		capture_window();
		posture_eval(win, win_ok, WINDOW_SAMPLES, &r);

		int64_t now = k_uptime_get();

		printk("[%u s] %s ", (uint32_t)(now / 1000), posture_status_str(r.status));
		if (r.status != POSTURE_INVALID) {
			print_f1("angle", r.angle_deg);
		}
		print_f1("std_mg", r.amag_std_mg);
		printk("valid=%d/%d\n", r.n_valid, WINDOW_SAMPLES);

		if (r.status == POSTURE_BAD && vibration_on &&
		    now - last_vib >= (int64_t)VIB_MIN_INTERVAL_S * 1000) {
			int err = vibro_alert();

			printk("  -> vibration%s\n", err ? " (I2C ERROR)" : "");
			last_vib = k_uptime_get();
		}

		/* The reading goes into the buffer; it is sent now if the link is ready */
		ble_submit(&r, now);
		if (ble_flush() == 0) {
			printk("  BLE: link not ready, %d reading(s) in the buffer\n", ble_pending());
		}

		const struct bno055_stats *st = bno055_get_stats();

		printk("  bus: lost=%u retries=%u mismatches=%u\n",
		       st->failed, st->retries, st->mismatches);

		/* Wait until the next interval. Every 100 ms it services BLE (sends
		 * what is pending after reconnecting, deletes bonds) and the button can cut it short. */
		while (!recalibrate && k_uptime_get() - t0 < (int64_t)interval_s * 1000) {
			service_ble();
			k_msleep(100);
		}
	}
	return 0;
}
```

## src/ble.c
```c
/* CorPost BLE.
 *
 * - GAP: the nRF52 is a peripheral. It advertises as "CorPost" with the service UUID.
 * - GATT: custom service with three characteristics (D3):
 *     Reading (Notify)  device -> app, 24 B packet
 *     Command (Write)   app -> device, opcode + parameter
 *     Time    (Write)   app -> device, uint32 LE with the UTC time
 * - Security: LE Secure Connections with passkey (level 4: AES-CCM encryption and
 *   authenticated against MITM). All characteristics require that level.
 *   Bonding stored in flash and only one phone paired at a time.
 * - Circular reading buffer: readings that cannot be sent are stored and sent as a
 *   burst on reconnection. */
#include "ble.h"
#include "config.h"

#include <zephyr/kernel.h>
#include <zephyr/bluetooth/bluetooth.h>
#include <zephyr/bluetooth/conn.h>
#include <zephyr/bluetooth/gatt.h>
#include <zephyr/bluetooth/hci.h>
#include <zephyr/bluetooth/uuid.h>
#include <zephyr/settings/settings.h>
#include <zephyr/sys/byteorder.h>
#include <zephyr/sys/crc.h>
#include <string.h>
#include <math.h>

/* ---------------------------------------------------------------------------
 * UUIDs (128 bits, custom). Random base bd5fXXXX-319b-420e-ae78-678d1c7cf46d
 * --------------------------------------------------------------------------- */
#define CORPOST_UUID(n) BT_UUID_128_ENCODE(0xbd5f0000 + (n), 0x319b, 0x420e, 0xae78, 0x678d1c7cf46d)

#define BT_UUID_CORPOST_SERVICE_VAL CORPOST_UUID(1)
static const struct bt_uuid_128 uuid_service = BT_UUID_INIT_128(CORPOST_UUID(1));
static const struct bt_uuid_128 uuid_reading = BT_UUID_INIT_128(CORPOST_UUID(2));
static const struct bt_uuid_128 uuid_command = BT_UUID_INIT_128(CORPOST_UUID(3));
static const struct bt_uuid_128 uuid_time = BT_UUID_INIT_128(CORPOST_UUID(4));

static const struct ble_cmd_handlers *cmd;

/* ---------------------------------------------------------------------------
 * UTC time. The nRF has no real-time clock: the app writes the UTC time on connect and
 * from then on it is tracked with the uptime (kept by the chip's RTC).
 * --------------------------------------------------------------------------- */
static struct k_spinlock time_lock;
static bool time_set;
static uint32_t utc_ref;       /* UTC time received (s) */
static int64_t utc_ref_uptime; /* uptime at that moment (ms) */

static bool uptime_to_utc(int64_t uptime_ms, uint32_t *utc)
{
	bool ok;
	k_spinlock_key_t key = k_spin_lock(&time_lock);

	ok = time_set;
	if (ok) {
		*utc = (uint32_t)((int64_t)utc_ref + (uptime_ms - utc_ref_uptime) / 1000);
	}
	k_spin_unlock(&time_lock, key);
	return ok;
}

/* ---------------------------------------------------------------------------
 * Circular reading buffer (D3: 50 entries, overwrites the oldest one).
 * Only the main thread uses it (ble_submit / ble_flush), so it needs no lock.
 * It stores the uptime and not the UTC time: this way, readings taken before the
 * time is received get their correct timestamp once the app writes it.
 * --------------------------------------------------------------------------- */
struct entry {
	int16_t acc[3];
	int16_t gyr[3];
	float angle;
	uint8_t status;
	int64_t uptime_ms;
};

static struct entry ring[BUFFER_SIZE];
static int ring_head; /* next free position */
static int ring_count;

static int16_t to_i16(float v)
{
	v = roundf(v);
	if (v > INT16_MAX) {
		return INT16_MAX;
	}
	if (v < INT16_MIN) {
		return INT16_MIN;
	}
	return (int16_t)v;
}

void ble_submit(const struct window_result *r, int64_t uptime_ms)
{
	struct entry *e = &ring[ring_head];

	if (ring_count == BUFFER_SIZE) {
		printk("  buffer full: the oldest reading is discarded\n");
	} else {
		ring_count++;
	}
	for (int k = 0; k < 3; k++) {
		e->acc[k] = to_i16(r->acc_mean[k]);           /* mg */
		e->gyr[k] = to_i16(r->gyr_mean_dps[k] * 16.0f); /* 1/16 dps (BNO055 LSB) */
	}
	e->angle = (r->status == POSTURE_INVALID) ? 0.0f : r->angle_deg;
	e->status = (uint8_t)r->status;
	e->uptime_ms = uptime_ms;
	ring_head = (ring_head + 1) % BUFFER_SIZE;
}

int ble_pending(void)
{
	return ring_count;
}

uint16_t ble_crc16(const uint8_t *data, int len)
{
	/* CRC-16/CCITT-FALSE = crc16_itu_t with seed 0xFFFF ("123456789" -> 0x29B1) */
	return crc16_itu_t(0xFFFF, data, len);
}

/* 24 B packet, little-endian (D3, telemetry packet table) */
static void encode(const struct entry *e, uint32_t ts, uint8_t out[BLE_READING_LEN])
{
	uint32_t angle_bits;

	for (int k = 0; k < 3; k++) {
		sys_put_le16((uint16_t)e->acc[k], &out[0 + 2 * k]);
		sys_put_le16((uint16_t)e->gyr[k], &out[6 + 2 * k]);
	}
	memcpy(&angle_bits, &e->angle, 4); /* float32 IEEE-754 */
	sys_put_le32(angle_bits, &out[12]);
	out[16] = e->status & 0x03;
	out[17] = BATTERY_LEVEL;
	sys_put_le32(ts, &out[18]);
	sys_put_le16(ble_crc16(out, 22), &out[22]);
}

/* ---------------------------------------------------------------------------
 * GATT service
 * --------------------------------------------------------------------------- */
static ssize_t write_command(struct bt_conn *conn, const struct bt_gatt_attr *attr,
			     const void *buf, uint16_t len, uint16_t offset, uint8_t flags)
{
	const uint8_t *b = buf;

	if (offset != 0) {
		return BT_GATT_ERR(BT_ATT_ERR_INVALID_OFFSET);
	}
	if (len < 1 || len > 4) {
		return BT_GATT_ERR(BT_ATT_ERR_INVALID_ATTRIBUTE_LEN);
	}

	switch (b[0]) {
	case CMD_SET_INTERVAL: {
		if (len != 3) {
			return BT_GATT_ERR(BT_ATT_ERR_INVALID_ATTRIBUTE_LEN);
		}
		uint16_t s = sys_get_le16(&b[1]);

		if (s < MEASURE_INTERVAL_MIN_S || s > MEASURE_INTERVAL_MAX_S) {
			return BT_GATT_ERR(BT_ATT_ERR_VALUE_NOT_ALLOWED);
		}
		printk("BLE command: interval = %u s\n", s);
		cmd->set_interval(s);
		break;
	}
	case CMD_SET_TOLERANCE:
		if (len != 2) {
			return BT_GATT_ERR(BT_ATT_ERR_INVALID_ATTRIBUTE_LEN);
		}
		if (b[1] < TOLERANCE_MIN_DEG || b[1] > TOLERANCE_MAX_DEG) {
			return BT_GATT_ERR(BT_ATT_ERR_VALUE_NOT_ALLOWED);
		}
		printk("BLE command: tolerance = %u degrees\n", b[1]);
		cmd->set_tolerance(b[1]);
		break;
	case CMD_RECALIBRATE:
		if (len != 1) {
			return BT_GATT_ERR(BT_ATT_ERR_INVALID_ATTRIBUTE_LEN);
		}
		printk("BLE command: recalibrate\n");
		cmd->recalibrate();
		break;
	case CMD_SET_VIBRATION:
		if (len != 2 || b[1] > 1) {
			return BT_GATT_ERR(BT_ATT_ERR_VALUE_NOT_ALLOWED);
		}
		printk("BLE command: vibration %s\n", b[1] ? "ON" : "OFF");
		cmd->set_vibration(b[1] != 0);
		break;
	default:
		printk("BLE unknown command 0x%02x\n", b[0]);
		return BT_GATT_ERR(BT_ATT_ERR_VALUE_NOT_ALLOWED);
	}
	return len;
}

static ssize_t write_time(struct bt_conn *conn, const struct bt_gatt_attr *attr,
			  const void *buf, uint16_t len, uint16_t offset, uint8_t flags)
{
	if (offset != 0) {
		return BT_GATT_ERR(BT_ATT_ERR_INVALID_OFFSET);
	}
	if (len != 4) {
		return BT_GATT_ERR(BT_ATT_ERR_INVALID_ATTRIBUTE_LEN);
	}

	k_spinlock_key_t key = k_spin_lock(&time_lock);

	utc_ref = sys_get_le32(buf);
	utc_ref_uptime = k_uptime_get();
	time_set = true;
	k_spin_unlock(&time_lock, key);

	printk("BLE UTC time = %u\n", sys_get_le32(buf));
	return len;
}

static void reading_ccc_changed(const struct bt_gatt_attr *attr, uint16_t value)
{
	printk("BLE Reading notifications %s\n",
	       value == BT_GATT_CCC_NOTIFY ? "enabled" : "disabled");
}

/* *_AUTHEN permissions: only with an encrypted and authenticated link (paired with passkey).
 * The CUDs (human-readable names in nRF Connect) are public: they contain no data. */
BT_GATT_SERVICE_DEFINE(corpost_svc,
	BT_GATT_PRIMARY_SERVICE(&uuid_service),

	/* attrs[1] declaration, attrs[2] value */
	BT_GATT_CHARACTERISTIC(&uuid_reading.uuid, BT_GATT_CHRC_NOTIFY,
			       BT_GATT_PERM_NONE, NULL, NULL, NULL),
	BT_GATT_CCC(reading_ccc_changed, BT_GATT_PERM_READ_AUTHEN | BT_GATT_PERM_WRITE_AUTHEN),
	BT_GATT_CUD("Reading", BT_GATT_PERM_READ),

	BT_GATT_CHARACTERISTIC(&uuid_command.uuid, BT_GATT_CHRC_WRITE,
			       BT_GATT_PERM_WRITE_AUTHEN, NULL, write_command, NULL),
	BT_GATT_CUD("Command", BT_GATT_PERM_READ),

	BT_GATT_CHARACTERISTIC(&uuid_time.uuid, BT_GATT_CHRC_WRITE,
			       BT_GATT_PERM_WRITE_AUTHEN, NULL, write_time, NULL),
	BT_GATT_CUD("Time", BT_GATT_PERM_READ),
);

#define READING_ATTR (&corpost_svc.attrs[1])

/* ---------------------------------------------------------------------------
 * Advertising: flags + service UUID + name (3 + 18 + 9 = 30 of 31 B)
 * --------------------------------------------------------------------------- */
static const struct bt_data ad[] = {
	BT_DATA_BYTES(BT_DATA_FLAGS, (BT_LE_AD_GENERAL | BT_LE_AD_NO_BREDR)),
	BT_DATA_BYTES(BT_DATA_UUID128_ALL, BT_UUID_CORPOST_SERVICE_VAL),
	BT_DATA(BT_DATA_NAME_COMPLETE, CONFIG_BT_DEVICE_NAME, sizeof(CONFIG_BT_DEVICE_NAME) - 1),
};

static struct k_work adv_work;

static void adv_work_handler(struct k_work *work)
{
	/* Connectable, interval 100-150 ms (FAST_2) */
	int err = bt_le_adv_start(BT_LE_ADV_CONN_FAST_2, ad, ARRAY_SIZE(ad), NULL, 0);

	if (err) {
		printk("BLE: could not start advertising (%d)\n", err);
		return;
	}
	printk("BLE: advertising as \"%s\"\n", CONFIG_BT_DEVICE_NAME);
}

/* ---------------------------------------------------------------------------
 * Connection
 * --------------------------------------------------------------------------- */
static K_MUTEX_DEFINE(conn_lock);
static struct bt_conn *cur_conn;

static void print_addr(const char *msg, struct bt_conn *conn)
{
	char addr[BT_ADDR_LE_STR_LEN];

	bt_addr_le_to_str(bt_conn_get_dst(conn), addr, sizeof(addr));
	printk("%s %s\n", msg, addr);
}

static void print_params(const char *msg, uint32_t interval_us, uint16_t latency,
			 uint16_t timeout_10ms)
{
	printk("%s interval=%u.%02u ms latency=%u timeout=%u ms\n", msg,
	       interval_us / 1000, (interval_us % 1000) / 10, latency, timeout_10ms * 10);
}

static void connected(struct bt_conn *conn, uint8_t err)
{
	struct bt_conn_info info;

	if (err) {
		printk("BLE: connection failed 0x%02x %s\n", err, bt_hci_err_to_str(err));
		return;
	}
	print_addr("BLE: connected to", conn);
	if (bt_conn_get_info(conn, &info) == 0) {
		print_params("BLE: initial parameters", info.le.interval_us, info.le.latency,
			     info.le.timeout);
	}

	k_mutex_lock(&conn_lock, K_FOREVER);
	cur_conn = bt_conn_ref(conn);
	k_mutex_unlock(&conn_lock);

	/* Request security level 4 from the start: if the phone is already paired it is
	 * only re-encrypted; otherwise, passkey pairing starts.
	 * An int is used rather than the callback's uint8_t 'err': the error is negative
	 * (e.g. -ENOMEM = -12, which would print as 244 as a uint8_t). */
	int sec_err = bt_conn_set_security(conn, BT_SECURITY_L4);

	if (sec_err) {
		printk("BLE: error requesting security (%d)%s\n", sec_err,
		       sec_err == -ENOMEM ? ": no room for another bond (CONFIG_BT_MAX_PAIRED)"
					  : "");
	}
}

static void disconnected(struct bt_conn *conn, uint8_t reason)
{
	printk("BLE: disconnected, reason 0x%02x %s\n", reason, bt_hci_err_to_str(reason));

	k_mutex_lock(&conn_lock, K_FOREVER);
	if (cur_conn == conn) {
		bt_conn_unref(cur_conn);
		cur_conn = NULL;
	}
	k_mutex_unlock(&conn_lock);
}

/* The previous connection is already released: advertise again */
static void recycled(void)
{
	k_work_submit(&adv_work);
}

static void le_param_updated(struct bt_conn *conn, uint16_t interval, uint16_t latency,
			     uint16_t timeout)
{
	print_params("BLE: updated parameters", interval * 1250U, latency, timeout);
}

static void security_changed(struct bt_conn *conn, bt_security_t level,
			     enum bt_security_err err)
{
	if (err) {
		printk("BLE: security failure, level %u, error %d %s\n", level, err,
		       bt_security_err_to_str(err));
		return;
	}
	printk("BLE: security level %u%s\n", level,
	       level >= BT_SECURITY_L4 ? " (LE Secure Connections, authenticated and encrypted)" : "");
}

BT_CONN_CB_DEFINE(conn_callbacks) = {
	.connected = connected,
	.disconnected = disconnected,
	.recycled = recycled,
	.le_param_updated = le_param_updated,
	.security_changed = security_changed,
};

static void mtu_updated(struct bt_conn *conn, uint16_t tx, uint16_t rx)
{
	printk("BLE: MTU updated tx=%u rx=%u\n", tx, rx);
}

static struct bt_gatt_cb gatt_callbacks = {
	.att_mtu_updated = mtu_updated,
};

/* ---------------------------------------------------------------------------
 * Pairing: the nRF "displays" the passkey (over RTT) and the user types it on the
 * phone. I/O capability = DisplayOnly -> Passkey Entry method -> protected
 * against MITM.
 * --------------------------------------------------------------------------- */
static void auth_passkey_display(struct bt_conn *conn, unsigned int passkey)
{
	printk("\n=============================================\n");
	printk("  PAIRING CODE: %06u\n", passkey);
	printk("  Enter it on the phone\n");
	printk("=============================================\n\n");
}

static void auth_cancel(struct bt_conn *conn)
{
	printk("BLE: pairing cancelled\n");
}

static void pairing_complete(struct bt_conn *conn, bool bonded)
{
	printk("BLE: pairing complete%s\n", bonded ? ", bond saved to flash" : "");
}

static void pairing_failed(struct bt_conn *conn, enum bt_security_err reason)
{
	printk("BLE: pairing failed: %d %s\n", reason, bt_security_err_to_str(reason));
	printk("     (if another phone is already paired, delete the bond with Button 2)\n");
}

static struct bt_conn_auth_cb auth_callbacks = {
	.passkey_display = auth_passkey_display,
	.cancel = auth_cancel,
};

static struct bt_conn_auth_info_cb auth_info_callbacks = {
	.pairing_complete = pairing_complete,
	.pairing_failed = pairing_failed,
};

static void count_bond(const struct bt_bond_info *info, void *user_data)
{
	char addr[BT_ADDR_LE_STR_LEN];

	bt_addr_le_to_str(&info->addr, addr, sizeof(addr));
	printk("  bond: %s\n", addr);
	(*(int *)user_data)++;
}

/* Print the stored bonds and return how many there are */
static int list_bonds(void)
{
	int bonds = 0;

	bt_foreach_bond(BT_ID_DEFAULT, count_bond, &bonds);
	printk("BLE: %d paired phone(s) stored (max %d)\n", bonds,
	       CONFIG_BT_MAX_PAIRED);
	return bonds;
}

/* ---------------------------------------------------------------------------
 * Public API
 * --------------------------------------------------------------------------- */
int ble_init(const struct ble_cmd_handlers *handlers)
{
	int err;

	cmd = handlers;

	err = bt_conn_auth_cb_register(&auth_callbacks);
	err |= bt_conn_auth_info_cb_register(&auth_info_callbacks);
	if (err) {
		printk("BLE: error registering security callbacks\n");
		return -EIO;
	}
	bt_gatt_cb_register(&gatt_callbacks);

	err = bt_enable(NULL);
	if (err) {
		printk("BLE: bt_enable failed (%d)\n", err);
		return err;
	}
	/* Load the stored bonds (keys) and subscriptions from flash */
	settings_load();

	list_bonds();

	k_work_init(&adv_work, adv_work_handler);
	k_work_submit(&adv_work);
	return 0;
}

/* The link is ready to send readings */
static bool link_ready(struct bt_conn *conn)
{
	bool has_time;
	k_spinlock_key_t key = k_spin_lock(&time_lock);

	has_time = time_set;
	k_spin_unlock(&time_lock, key);

	return bt_conn_get_security(conn) >= BT_SECURITY_L4 &&
	       bt_gatt_is_subscribed(conn, READING_ATTR, BT_GATT_CCC_NOTIFY) &&
	       bt_gatt_get_mtu(conn) >= BLE_READING_LEN + 3 && /* 3 B of ATT header */
	       has_time; /* without time, the timestamp would be 0 and the app would deduplicate it */
}

int ble_flush(void)
{
	struct bt_conn *conn = NULL;
	int sent = 0;

	if (ring_count == 0) {
		return 0;
	}

	k_mutex_lock(&conn_lock, K_FOREVER);
	if (cur_conn) {
		conn = bt_conn_ref(cur_conn);
	}
	k_mutex_unlock(&conn_lock);
	if (!conn) {
		return 0;
	}

	while (ring_count > 0 && link_ready(conn)) {
		int tail = (ring_head - ring_count + BUFFER_SIZE) % BUFFER_SIZE;
		uint8_t pkt[BLE_READING_LEN];
		uint32_t ts = 0;

		uptime_to_utc(ring[tail].uptime_ms, &ts);
		encode(&ring[tail], ts, pkt);

		/* From the main thread, if there are no free buffers, bt_gatt_notify WAITS
		 * until one is released (the burst goes at the pace of the link). It returns an
		 * error if the connection drops: the reading stays in the buffer for next time. */
		if (bt_gatt_notify(conn, READING_ATTR, pkt, sizeof(pkt)) != 0) {
			break;
		}
		ring_count--;
		sent++;
	}
	bt_conn_unref(conn);

	if (sent > 0) {
		printk("  BLE: %d reading(s) sent, %d pending\n", sent, ring_count);
	}
	return sent;
}

void ble_clear_bonds(void)
{
	k_mutex_lock(&conn_lock, K_FOREVER);
	if (cur_conn) {
		bt_conn_disconnect(cur_conn, BT_HCI_ERR_REMOTE_USER_TERM_CONN);
	}
	k_mutex_unlock(&conn_lock);

	int err = bt_unpair(BT_ID_DEFAULT, BT_ADDR_LE_ANY);

	printk("BLE: pairings deleted%s\n", err ? " (ERROR)" : "");
	list_bonds(); /* check: must be 0 */
}
```

## src/ble.h
```c
/* CorPost BLE: custom GATT service, security (LE Secure Connections) and a
 * circular reading buffer for disconnections. */
#pragma once
#include <stdbool.h>
#include <stdint.h>
#include "posture.h"

/* Reading packet size (D3): 22 B of data + 2 B of CRC-16 */
#define BLE_READING_LEN 24

/* Opcodes of the Command characteristic (D3) */
#define CMD_SET_INTERVAL  0x01 /* + uint16 LE: seconds */
#define CMD_SET_TOLERANCE 0x02 /* + uint8: degrees */
#define CMD_RECALIBRATE   0x03 /* no parameter */
#define CMD_SET_VIBRATION 0x04 /* + uint8: 0 = off, 1 = on */

/* Actions that the app can request through the Command characteristic. They are called from
  the Bluetooth thread: they must be fast (only store the value or set a flag). */
struct ble_cmd_handlers {
	void (*set_interval)(uint16_t seconds);
	void (*set_tolerance)(uint8_t degrees);
	void (*recalibrate)(void);
	void (*set_vibration)(bool on);
};

/* Start Bluetooth, load the stored pairings and start advertising. */
int ble_init(const struct ble_cmd_handlers *handlers);

/* Store a reading in the circular buffer (it is sent when the link is ready). */
void ble_submit(const struct window_result *r, int64_t uptime_ms);

/* Send all pending readings if the link is ready:
  connected + encrypted and authenticated + subscribed + enough MTU + time received.
  Returns how many have been sent. */
int ble_flush(void);

/* Readings pending in the buffer */
int ble_pending(void);

/* Delete all pairings (bonds) and drop the current connection. */
void ble_clear_bonds(void);

/* CRC-16/CCITT-FALSE (poly 0x1021, init 0xFFFF): the packet CRC */
uint16_t ble_crc16(const uint8_t *data, int len);
```

## src/bno055.c
```c
#include "bno055.h"

#include <zephyr/kernel.h>
#include <zephyr/drivers/i2c.h>
#include <zephyr/sys/byteorder.h>
#include <zephyr/sys/util.h>
#include <errno.h>
#include <stdlib.h>

/* Page 0 */
#define REG_CHIP_ID     0x00 /* must be 0xA0 */
#define REG_PAGE_ID     0x07 /* exists on both pages */
#define REG_ACC_DATA    0x08 /* X,Y,Z LSB/MSB */
#define REG_GYR_DATA    0x14
#define REG_UNIT_SEL    0x3B
#define REG_OPR_MODE    0x3D
#define REG_PWR_MODE    0x3E
#define REG_SYS_TRIG    0x3F
/* Page 1 */
#define REG_ACC_CONFIG  0x08 /* bits 1:0 range, 4:2 bandwidth */
#define REG_GYR_CONFIG0 0x0A /* bits 2:0 range, 5:3 bandwidth */

#define CHIP_ID         0xA0
#define MODE_CONFIG     0x00
#define MODE_ACCGYRO    0x05
#define ACC_CFG         0x05 /* +-4 g, BW 15.63 Hz */
#define GYR_CFG         0x28 /* +-2000 dps, BW 12 Hz */

/* With the current wiring (long cables), reads of more than 2 consecutive bytes get
  corrupted; 2-byte reads are reliable. Each axis is read in its own
  transaction, with retries and a verification double read. */
#define READ_RETRIES    3
#define MAX_DIFF        200

static const struct device *bus;
static uint8_t addr;
static struct bno055_stats stats;

static int wr(uint8_t reg, uint8_t val)
{
	uint8_t buf[2] = {reg, val};

	return i2c_write(bus, buf, sizeof(buf), addr);
}

static int read_i16_once(uint8_t reg, int16_t *out)
{
	uint8_t b[2];
	int err = 0;

	for (int i = 0; i < READ_RETRIES; i++) {
		err = i2c_write_read(bus, addr, &reg, 1, b, 2);
		if (err == 0) {
			*out = sys_get_le16(b);
			return 0;
		}
		stats.retries++;
	}
	return err;
}

static int read_i16(uint8_t reg, int16_t *out)
{
	for (int i = 0; i < READ_RETRIES; i++) {
		int16_t a, b;

		if (read_i16_once(reg, &a) || read_i16_once(reg, &b)) {
			return -EIO;
		}
		if (abs(a - b) <= MAX_DIFF) {
			*out = b;
			return 0;
		}
		stats.mismatches++;
	}
	return -EIO;
}

int bno055_init(const struct device *i2c)
{
	static const uint8_t cand[] = {0x28, 0x29};
	int err = 0;

	bus = i2c;
	addr = 0;
	for (int i = 0; i < ARRAY_SIZE(cand); i++) {
		uint8_t id = 0;

		if (i2c_reg_read_byte(bus, cand[i], REG_CHIP_ID, &id) == 0 && id == CHIP_ID) {
			addr = cand[i];
			break;
		}
	}
	if (addr == 0) {
		return -ENODEV;
	}

	err |= wr(REG_OPR_MODE, MODE_CONFIG); /* settings are only applied in CONFIG mode */
	k_msleep(25);
	err |= wr(REG_PWR_MODE, 0x00);        /* normal */
	err |= wr(REG_UNIT_SEL, 0x01);        /* acc in mg, gyro in dps */
	err |= wr(REG_SYS_TRIG, 0x00);        /* internal clock */
	err |= wr(REG_PAGE_ID, 1);
	err |= wr(REG_ACC_CONFIG, ACC_CFG);
	err |= wr(REG_GYR_CONFIG0, GYR_CFG);
	err |= wr(REG_PAGE_ID, 0);
	err |= wr(REG_OPR_MODE, MODE_ACCGYRO);
	k_msleep(25);

	return err ? -EIO : 0;
}

int bno055_read(struct imu_sample *s)
{
	for (int i = 0; i < 3; i++) {
		if (read_i16(REG_ACC_DATA + 2 * i, &s->acc[i]) ||
		    read_i16(REG_GYR_DATA + 2 * i, &s->gyr[i])) {
			stats.failed++;
			return -EIO;
		}
	}
	return 0;
}

uint8_t bno055_addr(void)
{
	return addr;
}

const struct bno055_stats *bno055_get_stats(void)
{
	return &stats;
}
```

## src/bno055.h
```c
/* Minimal BNO055 driver (accelerometer + gyroscope, no fusion) over I2C. */
#pragma once
#include <zephyr/device.h>
#include <stdint.h>

struct imu_sample {
	int16_t acc[3]; /* mg, includes gravity */
	int16_t gyr[3]; /* 1 LSB = 1/16 dps */
};

struct bno055_stats {
	uint32_t retries;    /* I2C reads repeated because of a bus error */
	uint32_t mismatches; /* double reads that did not match */
	uint32_t failed;     /* lost samples */
};

/* Find the sensor (0x28/0x29), configure it and leave it measuring. 0 on success. */
int bno055_init(const struct device *i2c);

/* Read one sample (6 axes). 0 on success, <0 if it was lost. */
int bno055_read(struct imu_sample *s);

uint8_t bno055_addr(void);
const struct bno055_stats *bno055_get_stats(void);
```

## src/config.h
```c
/* CorPost firmware parameters (PoC).
  The development values can be adjusted depending on what is being tested;
  the final values will be decided after testing. */
#pragma once

/* Sampling: 2 s window at 25 Hz (50 samples), as in D3 */
#define SAMPLE_PERIOD_MS     40
#define WINDOW_SAMPLES       50
#define MIN_VALID_SAMPLES    40   /* if more samples are lost over I2C, the window is INVALID */

/* Interval between measurements. Development: 15 s (D3: 1, 3 or 5 min).
  It is the initial value: the app can change it with command 0x01. */
#define MEASURE_INTERVAL_S     15
#define MEASURE_INTERVAL_MIN_S 5    /* limits accepted by command 0x01 */
#define MEASURE_INTERVAL_MAX_S 3600

/* Tolerance margin: deviation from the reference posture beyond which the
  posture is BAD. Initial value: the app changes it with command 0x02. */
#define TOLERANCE_DEG        15.0f
#define TOLERANCE_MIN_DEG    1      /* limits accepted by command 0x02 */
#define TOLERANCE_MAX_DEG    90

/* Circular reading buffer for BLE disconnections (D3: 50 readings) */
#define BUFFER_SIZE          50

/* "Battery" field of the packet. The PoC has no battery (USB): 0xFF = not available */
#define BATTERY_LEVEL        0xFF

/* PROVISIONAL motion filter: threshold on the standard deviation of the magnitude
  of the acceleration within the window (0.042 g = baseline of the HAPT pipeline).
  It will be replaced by the decision tree retrained at 25 Hz. */
#define MOTION_STD_MG        42.0f

/* Vibration: minimum time between two alerts. Development: 0 (vibrates on every BAD).
  D3: 300 s (5 min). */
#define VIB_MIN_INTERVAL_S   0
```

## src/posture.c
```c
#include "posture.h"
#include "config.h"

#include <math.h>
#include <stdbool.h>

#define RAD2DEG 57.29577951f

static float ref[3] = {0.0f, 0.0f, 1000.0f};
static volatile float tolerance_deg = TOLERANCE_DEG; /* changed by the app over BLE */

void posture_set_tolerance(float deg)
{
	tolerance_deg = deg;
}

static float norm3(const float v[3])
{
	return sqrtf(v[0] * v[0] + v[1] * v[1] + v[2] * v[2]);
}

static float angle_between(const float a[3], const float b[3])
{
	float na = norm3(a), nb = norm3(b);

	if (na < 1e-3f || nb < 1e-3f) {
		return 0.0f;
	}
	float c = (a[0] * b[0] + a[1] * b[1] + a[2] * b[2]) / (na * nb);

	c = c > 1.0f ? 1.0f : (c < -1.0f ? -1.0f : c);
	return acosf(c) * RAD2DEG;
}

void posture_window_stats(const struct imu_sample *s, const bool *ok, int n, struct window_result *r)
{
	float sum_mag = 0.0f, sum_mag2 = 0.0f;

	*r = (struct window_result){0};
	for (int i = 0; i < n; i++) {
		if (!ok[i]) {
			continue;
		}
		float a[3] = {s[i].acc[0], s[i].acc[1], s[i].acc[2]};
		float m = norm3(a);

		for (int k = 0; k < 3; k++) {
			r->acc_mean[k] += a[k];
			r->gyr_mean_dps[k] += s[i].gyr[k] / 16.0f;
		}
		sum_mag += m;
		sum_mag2 += m * m;
		r->n_valid++;
	}
	if (r->n_valid == 0) {
		return;
	}
	for (int k = 0; k < 3; k++) {
		r->acc_mean[k] /= r->n_valid;
		r->gyr_mean_dps[k] /= r->n_valid;
	}
	float mean = sum_mag / r->n_valid;
	float var = sum_mag2 / r->n_valid - mean * mean;

	r->amag_std_mg = var > 0.0f ? sqrtf(var) : 0.0f;
}

void posture_set_reference(const float acc_mean[3])
{
	for (int k = 0; k < 3; k++) {
		ref[k] = acc_mean[k];
	}
}

void posture_eval(const struct imu_sample *s, const bool *ok, int n, struct window_result *r)
{
	posture_window_stats(s, ok, n, r);

	/* PROVISIONAL motion filter (threshold). TODO: decision tree. */
	if (r->n_valid < MIN_VALID_SAMPLES || r->amag_std_mg > MOTION_STD_MG) {
		r->status = POSTURE_INVALID;
		return;
	}
	r->angle_deg = angle_between(r->acc_mean, ref);
	r->status = r->angle_deg > tolerance_deg ? POSTURE_BAD : POSTURE_OK;
}

const char *posture_status_str(enum posture_status st)
{
	switch (st) {
	case POSTURE_OK:
		return "OK";
	case POSTURE_BAD:
		return "BAD";
	default:
		return "INVALID";
	}
}
```

## src/posture.h
```c
/* Evaluation of a measurement window: motion filter + angle + status. */
#pragma once
#include <stdbool.h>
#include "bno055.h"

/* Same values as the "status" field of the BLE packet (D3, Table II) */
enum posture_status {
	POSTURE_OK = 0,
	POSTURE_BAD = 1,
	POSTURE_INVALID = 2,
};

struct window_result {
	int n_valid;            /* valid samples in the window */
	float acc_mean[3];      /* mg */
	float gyr_mean_dps[3];  /* dps */
	float amag_std_mg;      /* standard deviation of the acceleration magnitude */
	float angle_deg;        /* deviation from the reference (only if not INVALID) */
	enum posture_status status;
};

/* Mean and deviation of a window, without classifying it (used for calibration). */
void posture_window_stats(const struct imu_sample *s, const bool *ok, int n, struct window_result *r);

/* Store the reference posture (0°) from the mean gravity of a window. */
void posture_set_reference(const float acc_mean[3]);

/* Classify the window: INVALID if there is motion or samples are missing;
  otherwise OK/BAD depending on the angle and the tolerance. */
void posture_eval(const struct imu_sample *s, const bool *ok, int n, struct window_result *r);

/* Change the tolerance margin (degrees). It applies from the next window. */
void posture_set_tolerance(float deg);

const char *posture_status_str(enum posture_status st);
```

## src/vibro.c
```c
#include "vibro.h"

#include <zephyr/kernel.h>
#include <zephyr/drivers/i2c.h>
#include <zephyr/sys/byteorder.h>

static const struct device *bus;

int vibro_init(const struct device *i2c)
{
	uint8_t dummy;

	bus = i2c;
	return i2c_read(bus, &dummy, 1, VIBRO_ADDR);
}

/* Modulino Vibro format: 3 x uint32 little-endian: frequency, duration, power */
int vibro_pulse(uint32_t freq, uint32_t ms, uint32_t power)
{
	uint8_t buf[12];
	int err = 0;

	sys_put_le32(freq, &buf[0]);
	sys_put_le32(ms, &buf[4]);
	sys_put_le32(power, &buf[8]);

	/* the bus is unreliable with the current cables: retry */
	for (int i = 0; i < 3; i++) {
		err = i2c_write(bus, buf, sizeof(buf), VIBRO_ADDR);
		if (err == 0) {
			break;
		}
	}
	return err;
}

int vibro_alert(void)
{
	int err = vibro_pulse(1000, 300, 80);

	k_msleep(500);
	err |= vibro_pulse(1000, 300, 80);
	k_msleep(300);
	return err;
}
```

## src/vibro.h
```c
/* Arduino Modulino Vibro over I2C. */
#pragma once
#include <zephyr/device.h>
#include <stdint.h>

#define VIBRO_ADDR 0x38 /* default 7-bit address */

/* Check that the Modulino responds. 0 if present. */
int vibro_init(const struct device *i2c);

/* One pulse: frequency (Hz), duration (ms), power (0-100). Does not block. */
int vibro_pulse(uint32_t freq, uint32_t ms, uint32_t power);

/* Bad-posture alert: two short pulses (~1 s in total). Blocks for ~0.8 s. */
int vibro_alert(void);
```
